/*
 * RockChip. LCD_RGB1024x600 FOR 86V
 *
 */

/ {
	 	disp_power_ctr: power_ctr {
                        rockchip,debug = <0>;
                        /*lcd_en:lcd_en {
                                rockchip,power_type = <GPIO>;
                                gpios = <&gpio0 GPIO_B0 GPIO_ACTIVE_HIGH>;
                                rockchip,delay = <10>;
                        };

                        bl_en:bl_en {
                                rockchip,power_type = <GPIO>;
                                gpios = <&gpio0 GPIO_A2 GPIO_ACTIVE_HIGH>;
                                rockchip,delay = <10>;
                        };

                        bl_ctr:bl_ctr {
                                rockchip,power_type = <GPIO>;
                                gpios = <&gpio3 GPIO_D6 GPIO_ACTIVE_HIGH>;
                                rockchip,delay = <10>;
                        };*/

/*                        lcd_rst:lcd_rst {
                                rockchip,power_type = <GPIO>;
                                gpios = <&gpio8 GPIO_A6 GPIO_ACTIVE_LOW>;
                                rockchip,delay = <5>;
                        };
*/
                };


		disp_timings: display-timings {
                        native-mode = <&timing0>;
                        timing0: timing0 {
				screen-type = <SCREEN_RGB>;
				out-face    = <OUT_P888>;
				clock-frequency = <52000000>;
				hactive = <1024>;
				vactive = <600>;
				hback-porch = <160>;
				hfront-porch = <160>;
				vback-porch = <12>;
				vfront-porch = <23>;
				hsync-len = <10>;
				vsync-len = <10>;
				hsync-active = <0>;
				vsync-active = <0>;
				de-active = <0>;
				pixelclk-active = <0>;
				swap-rb = <0>;
				swap-rg = <0>;
				swap-gb = <0>;
                     	};
               };
};
